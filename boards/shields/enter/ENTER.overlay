/ {
	chosen {
       		zmk,kscan = &kscan0;
        	// zmk,physical-layout = &physical_layout0;
        	// Other chosen items
    	};
	
	kscan0: kscan0 {
        	compatible = "zmk,kscan-gpio-direct";
        	wakeup-source;
	
		input-gpios =
			<&pro_micro 1 (GPIO_ACTIVE_HIGH | GPIO_PULL_DOWN)>,
			<&pro_micro 2 (GPIO_ACTIVE_HIGH | GPIO_PULL_DOWN)>,
			<&pro_micro 3 (GPIO_ACTIVE_HIGH | GPIO_PULL_DOWN)>;
	};
};
